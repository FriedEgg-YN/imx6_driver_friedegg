## bsp/Config.in
```kconfig
source "$BR2_EXTERNAL_BSP_PATH/package/ap3216c/Config.in"
source "$BR2_EXTERNAL_BSP_PATH/package/ld2410c/Config.in"
source "$BR2_EXTERNAL_BSP_PATH/package/ov5640/Config.in"
source "$BR2_EXTERNAL_BSP_PATH/package/imx6-monitor/Config.in"
source "$BR2_EXTERNAL_BSP_PATH/package/imx6-qt5-demo/Config.in"
source "$BR2_EXTERNAL_BSP_PATH/package/imx6-smart-monitor/Config.in"
source "$BR2_EXTERNAL_BSP_PATH/package/gt9147/Config.in"
source "$BR2_EXTERNAL_BSP_PATH/package/print_chasing_led/Config.in"
```

## bsp/configs/imx6ull_friedegg_emmc_defconfig
```kconfig
BR2_arm=y
BR2_cortex_a7=y
BR2_ARM_FPU_NEON_VFPV4=y
BR2_PACKAGE_HOST_LINUX_HEADERS_CUSTOM_4_1=y
BR2_GCC_VERSION_13_X=y
BR2_TOOLCHAIN_BUILDROOT_CXX=y
BR2_PRIMARY_SITE="https://sources.buildroot.net"
BR2_CCACHE=y
BR2_ROOTFS_DEVICE_CREATION_DYNAMIC_MDEV=y
BR2_ROOTFS_OVERLAY="$(BR2_EXTERNAL_BSP_PATH)/rootfs_overlay"
BR2_LINUX_KERNEL=y
BR2_LINUX_KERNEL_CUSTOM_VERSION=y
BR2_LINUX_KERNEL_CUSTOM_VERSION_VALUE="custom"
BR2_LINUX_KERNEL_USE_CUSTOM_CONFIG=y
BR2_LINUX_KERNEL_CUSTOM_CONFIG_FILE="$(BR2_EXTERNAL_BSP_PATH)/configs/linux.config"
BR2_LINUX_KERNEL_DTS_SUPPORT=y
BR2_LINUX_KERNEL_INTREE_DTS_NAME="imx6ull-friedegg-emmc"
BR2_PACKAGE_BUSYBOX_CONFIG="$(BR2_EXTERNAL_BSP_PATH)/configs/busybox.config"
BR2_PACKAGE_QT5=y
BR2_PACKAGE_QT5BASE_DEFAULT_QPA="linuxfb"
BR2_PACKAGE_LIBV4L=y
BR2_PACKAGE_LIBV4L_UTILS=y
BR2_PACKAGE_DROPBEAR=y
# BR2_PACKAGE_DROPBEAR_CLIENT is not set
BR2_PACKAGE_DROPBEAR_DISABLE_REVERSEDNS=y
BR2_PACKAGE_AP3216C=y
BR2_PACKAGE_OV5640=y
BR2_PACKAGE_IMX6_QT5_DEMO=y
BR2_PACKAGE_IMX6_SMART_MONITOR=y
BR2_PACKAGE_GT9147=y
BR2_PACKAGE_PRINT_CHASING_LED=y
```

## bsp/package/ap3216c/Config.in
```kconfig
config BR2_PACKAGE_AP3216C
    bool "AP3216C driver"
    depends on BR2_LINUX_KERNEL
    help
      AP3216C I2C sensor custom kernel module.
```

## bsp/package/gt9147/Config.in
```kconfig
config BR2_PACKAGE_GT9147
    bool "GT9147 TS driver"
    depends on BR2_LINUX_KERNEL
    help
        GT9147 touch screen custom kernel module.
```

## bsp/package/imx6-monitor/Config.in
```kconfig
config BR2_PACKAGE_IMX6_MONITOR
	bool "imx6-monitor web camera service"
	depends on BR2_TOOLCHAIN_HAS_THREADS
	select BR2_PACKAGE_JPEG
	select BR2_PACKAGE_JPEG_TURBO
	help
	  Small C monitoring service for the i.MX6ULL BSP. It captures
	  OV5640 frames through V4L2 MMAP, keeps an optional framebuffer
	  preview, reads AP3216C data through IIO sysfs, and exposes
	  HTTP status, snapshot, MJPEG stream and local control endpoints.
```

## bsp/package/imx6-qt5-demo/Config.in
```kconfig
config BR2_PACKAGE_IMX6_QT5_DEMO
	bool "imx6 Qt5 linuxfb demo"
	depends on BR2_PACKAGE_QT5
	select BR2_PACKAGE_QT5BASE_GUI
	select BR2_PACKAGE_QT5BASE_WIDGETS
	select BR2_PACKAGE_QT5BASE_NETWORK
	select BR2_PACKAGE_QT5BASE_LINUXFB
	select BR2_PACKAGE_QT5BASE_FONTCONFIG
	select BR2_PACKAGE_QT5BASE_JPEG
	select BR2_PACKAGE_QT5BASE_PNG
	select BR2_PACKAGE_QT5BASE_TSLIB
	select BR2_PACKAGE_DEJAVU
	select BR2_PACKAGE_IMX6_MONITOR
	help
	  Qt5 Widgets touch HMI for controlling imx6-monitor on the
	  i.MX6ULL linuxfb glibc rootfs.

comment "imx6 Qt5 demo needs Qt5"
	depends on !BR2_PACKAGE_QT5
```

## bsp/package/imx6-smart-monitor/Config.in
```kconfig
config BR2_PACKAGE_IMX6_SMART_MONITOR
	bool "imx6 smart monitor Qt launcher and module test apps"
	depends on BR2_PACKAGE_QT5
	select BR2_PACKAGE_QT5BASE_GUI
	select BR2_PACKAGE_QT5BASE_WIDGETS
	select BR2_PACKAGE_QT5BASE_LINUXFB
	select BR2_PACKAGE_QT5BASE_FONTCONFIG
	select BR2_PACKAGE_QT5BASE_TSLIB
	select BR2_PACKAGE_QT5BASE_JPEG
	select BR2_PACKAGE_DEJAVU
	help
	  Qt5 Widgets launcher and module test apps for the smart monitor
	  skeleton. The launcher provides a phone-style home screen that opens
	  touch, AP3216C, LD2410C, OV5640/V4L2, storage and MonitorCore test
	  pages inside one foreground Qt application.

comment "imx6 smart monitor needs Qt5"
	depends on !BR2_PACKAGE_QT5
```

## bsp/package/ld2410c/Config.in
```kconfig
config BR2_PACKAGE_LD2410C
    bool "LD2410C radar driver + attach tool"
    depends on BR2_LINUX_KERNEL
    help
      LD2410C presence radar kernel module with OUT GPIO input,
      UART line discipline parser, misc ioctl UAPI and attach tool.
```

## bsp/package/ov5640/Config.in
```kconfig
config BR2_PACKAGE_OV5640
    bool "ov5640 camera driver + test app"
    depends on BR2_LINUX_KERNEL
    help
      OV5640 camera kernel module (ov5640.ko + mx6s_capture.ko)
      and V4L2 LCD preview test program.
```

## bsp/package/print_chasing_led/Config.in
```kconfig
config BR2_PACKAGE_PRINT_CHASING_LED
    bool "print chasing LED simulation driver"
    depends on BR2_LINUX_KERNEL
    help
      simulate chasing LED by printk.
```

## src/uboot-imx/board/freescale/mx6ull_friedegg_emmc/Kconfig
```kconfig
if TARGET_MX6ULL_FRIEDEGG_EMMC

config SYS_BOARD
	default "mx6ull_friedegg_emmc"

config SYS_VENDOR
	default "freescale"

config SYS_SOC
	default "mx6"

config SYS_CONFIG_NAME
	default "mx6ull_friedegg_emmc"

endif
```
